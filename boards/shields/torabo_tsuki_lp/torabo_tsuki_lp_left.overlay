#include "torabo_tsuki_lp.dtsi"
#include <input/processors.dtsi>
#include <dt-bindings/zmk/input_transform.h>

&pointing_listener {
    // zip_xy_scaler <multiplier> <divisor> : trackball speed = multiplier/divisor
    input-processors = <&zip_xy_transform (INPUT_TRANSFORM_X_INVERT | INPUT_TRANSFORM_Y_INVERT)>,
                        <&zip_xy_scaler 2 3>;

    // layer_1: trackball moves act as scroll instead of cursor movement
    scroller {
        layers = <1>;
        input-processors = <&zip_xy_transform (INPUT_TRANSFORM_X_INVERT | INPUT_TRANSFORM_Y_INVERT)>,
                            <&zip_xy_to_scroll_mapper>;
    };
};